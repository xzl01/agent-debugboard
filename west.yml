## west.yml
```yaml
# SPDX-License-Identifier: LGPL-3.0-or-later
#
# Copyright (c) Radxa Computer (Shenzhen) Co., Ltd.
# Copyright (c) xzl <xiangzelong@radxa.com>

manifest:
  remotes:
    - name: zephyrproject-rtos
      url-base: https://github.com/zephyrproject-rtos

  projects:
    - name: zephyr
      remote: zephyrproject-rtos
      revision: f3fc249035296b87c75fa808b3abf78829fe9378
      clone-depth: 1
      import:
        name-allowlist:
          - cmsis
          - cmsis_6
          - hal_rpi_pico
          - mbedtls
          - mcuboot
          - tf-psa-crypto

  self:
    path: .
```
